## CMakeLists.txt
```
cmake_minimum_required(VERSION 3.20.0)
find_package(Zephyr REQUIRED HINTS $ENV{ZEPHYR_BASE})
project(peripheral_nus)

target_sources(app PRIVATE
        src/board.c
        src/adc.c
        src/ble_nus.c
        src/sensors.c
        src/stts2004.c
        src/iim42652.c
        src/main.c


)
target_include_directories(app PRIVATE
        inc/
)
```

## prj.conf
```kconfig
CONFIG_CBPRINTF_FP_A_SUPPORT=y


# Bluetooth section
CONFIG_BT=y
CONFIG_BT_PERIPHERAL=y
CONFIG_BT_ZEPHYR_NUS=y
CONFIG_BT_DEVICE_NAME="sstest"
CONFIG_BT_L2CAP_TX_MTU=263
CONFIG_BT_BUF_ACL_RX_SIZE=267
CONFIG_BT_BUF_ACL_TX_SIZE=267

# Gpio section
CONFIG_GPIO=y
CONFIG_ADC=y

#Sensors section
CONFIG_SENSOR=y
CONFIG_I2C=y
CONFIG_SPI=y
```

## src/main.c
```c
#include "board.h"
#include "ble_nus.h"
#include "sensors.h"
#include "adc.h"
#include <zephyr/kernel.h>
#include "stts2004.h"
#include "iim42652.h"
#include <zephyr/drivers/gpio.h>

static void send_sensor_json(double temp, const iim42652_data_t *iim_data)
{
	char json[512];
	double voltage = 0.0;
	if (adc_measure(&voltage) != 0)
	{
		voltage = -1.0; // Indicate error
	}

	if (iim_data)
	{
		snprintf(json, sizeof(json),
				 "{"
				 "\"temperature\":%.2f,"
				 "\"voltage\":%.3f,"
				 "\"acc\":[%.2f,%.2f,%.2f],"
				 "\"gyro\":[%.2f,%.2f,%.2f],"
				 "\"imu_temp\":%.2f"
				 "}\n",
				 temp,
				 voltage,
				 iim_data->acc[0], iim_data->acc[1], iim_data->acc[2],
				 iim_data->gyro[0], iim_data->gyro[1], iim_data->gyro[2],
				 iim_data->temp);
	}
	else
	{
		snprintf(json, sizeof(json),
				 "{"
				 "\"temperature\":%.2f,"
				 "\"voltage\":%.3f"
				 "}\n",
				 temp,
				 voltage);
	}
	bt_nus_printf("%s", json);
}

// Function to send an error message as JSON over BLE
static void send_error_json(const char *error_msg)
{
	char json[128];
	snprintf(json, sizeof(json),
			 "{"
			 "\"error\":\"%s\""
			 "}\n",
			 error_msg);
	bt_nus_printf("%s", json);
}

int main(void)
{
	iim42652_data_t iim_data;
	double temperature;
	printk("Sample - Bluetooth Peripheral NUS\n");

	brd_init();
	ble_init();
	adc_init();

	printk("Initialization complete\n");

	while (1)
	{
		k_sleep(K_MSEC(50));

		if (STTS2004_temperature(&temperature) != 0)
		{
			printk("Failed to read temperature\n");
			send_error_json("Failed to read temperature");
			continue;
		}
		if (IIM42652_data(&iim_data) != 0)
		{
			printk("Failed to read IIM42652 data\n");
			send_error_json("Failed to read IIM42652 data");
			send_sensor_json(temperature, NULL);
			continue;
		}
		send_sensor_json(temperature, &iim_data);
		// Add
	}

	return 0;
}
```

## inc/adc.h
```c
#pragma once

#include <zephyr/drivers/adc.h>

int adc_init(void);
int adc_measure(double *voltage);
```

## inc/ble_nus.h
```c
#pragma once

extern int bt_nus_printf(const char *fmt, ...);
```

## inc/board.h
```c
#pragma once

extern void brd_init(void);
extern void sensor_init(void);
extern int ble_init(void);
```

## inc/iim42652.h
```c
#pragma once

typedef struct
{
    double acc[3];  // Accelerometer data in g
    double gyro[3]; // Gyroscope data in dps
    double temp;    // Temperature in Celsius
} iim42652_data_t;

extern int IIM42652_data(iim42652_data_t *iim_data);

#define IIM42652_DEVICE_CONFIG UINT8_C(0x11)
#define IIM42652_DRIVE_CONFIG UINT8_C(0x13)
#define IIM42652_INT_CONFIG UINT8_C(0x14)
#define IIM42652_FIFO_CONFIG UINT8_C(0x16)
#define IIM42652_TEMP_DATA1_UI UINT8_C(0x1D)
#define IIM42652_TEMP_DATA0_UI UINT8_C(0x1E)
#define IIM42652_ACCEL_DATA_X1_UI UINT8_C(0x1F)
#define IIM42652_ACCEL_DATA_X0_UI UINT8_C(0x20)
#define IIM42652_ACCEL_DATA_Y1_UI UINT8_C(0x21)
#define IIM42652_ACCEL_DATA_Y0_UI UINT8_C(0x22)
#define IIM42652_ACCEL_DATA_Z1_UI UINT8_C(0x23)
#define IIM42652_ACCEL_DATA_Z0_UI UINT8_C(0x24)
#define IIM42652_GYRO_DATA_X1_UI UINT8_C(0x25)
#define IIM42652_GYRO_DATA_X0_UI UINT8_C(0x26)
#define IIM42652_GYRO_DATA_Y1_UI UINT8_C(0x27)
#define IIM42652_GYRO_DATA_Y0_UI UINT8_C(0x28)
#define IIM42652_GYRO_DATA_Z1_UI UINT8_C(0x29)
#define IIM42652_GYRO_DATA_Z0_UI UINT8_C(0x2A)
#define IIM42652_TMST_FSYNCH UINT8_C(0x2B)
#define IIM42652_TMST_FSYNCL UINT8_C(0x2C)
#define IIM42652_INT_STATUS UINT8_C(0x2D)
#define IIM42652_FIFO_COUNTH UINT8_C(0x2E)
#define IIM42652_FIFO_COUNTL UINT8_C(0x2F)
#define IIM42652_FIFO_DATA UINT8_C(0x30)
#define IIM42652_APEX_DATA0 UINT8_C(0x31)
#define IIM42652_APEX_DATA1 UINT8_C(0x32)
#define IIM42652_APEX_DATA2 UINT8_C(0x33)
#define IIM42652_APEX_DATA3 UINT8_C(0x34)
#define IIM42652_APEX_DATA4 UINT8_C(0x35)
#define IIM42652_APEX_DATA5 UINT8_C(0x36)
#define IIM42652_INT_STATUS2 UINT8_C(0x37)
#define IIM42652_INT_STATUS3 UINT8_C(0x38)
#define IIM42652_SIGNAL_PATH_RESET UINT8_C(0x4B)
#define IIM42652_INTF_CONFIG0 UINT8_C(0x4C)
#define IIM42652_INTF_CONFIG1 UINT8_C(0x4D)
#define IIM42652_PWR_MGMT0 UINT8_C(0x4E)
#define IIM42652_GYRO_CONFIG0 UINT8_C(0x4F)
#define IIM42652_ACCEL_CONFIG0 UINT8_C(0x50)
#define IIM42652_GYRO_CONFIG1 UINT8_C(0x51)
#define IIM42652_GYRO_ACCEL_CONFIG0 UINT8_C(0x52)
#define IIM42652_ACCEL_CONFIG1 UINT8_C(0x53)
#define IIM42652_TMST_CONFIG UINT8_C(0x54)
#define IIM42652_APEX_CONFIG0 UINT8_C(0x56)
#define IIM42652_SMD_CONFIG UINT8_C(0x57)
#define IIM42652_FIFO_CONFIG1 UINT8_C(0x5F)
#define IIM42652_FIFO_CONFIG2 UINT8_C(0x60)
#define IIM42652_FIFO_CONFIG3 UINT8_C(0x61)
#define IIM42652_FSYNC_CONFIG UINT8_C(0x62)
#define IIM42652_INT_CONFIG0 UINT8_C(0x63)
#define IIM42652_INT_CONFIG1 UINT8_C(0x64)
#define IIM42652_INT_SOURCE0 UINT8_C(0x65)
#define IIM42652_INT_SOURCE1 UINT8_C(0x66)
#define IIM42652_INT_SOURCE3 UINT8_C(0x68)
#define IIM42652_INT_SOURCE4 UINT8_C(0x69)
#define IIM42652_FIFO_LOST_PKT0 UINT8_C(0x6C)
#define IIM42652_FIFO_LOST_PKT1 UINT8_C(0x6D)
#define IIM42652_SELF_TEST_CONFIG UINT8_C(0x70)
#define IIM42652_WHO_AM_I UINT8_C(0x75)
#define IIM42652_REG_BANK_SEL UINT8_C(0x76)

// Registers bank 1
#define IIM42652_SENSOR_CONFIG0 UINT8_C(0x03)
#define IIM42652_GYRO_CONFIG_STATIC2 UINT8_C(0x0B)
#define IIM42652_GYRO_CONFIG_STATIC3 UINT8_C(0x0C)
#define IIM42652_GYRO_CONFIG_STATIC4 UINT8_C(0x0D)
#define IIM42652_GYRO_CONFIG_STATIC5 UINT8_C(0x0E)
#define IIM42652_GYRO_CONFIG_STATIC6 UINT8_C(0x0F)
#define IIM42652_GYRO_CONFIG_STATIC7 UINT8_C(0x10)
#define IIM42652_GYRO_CONFIG_STATIC8 UINT8_C(0x11)
#define IIM42652_GYRO_CONFIG_STATIC9 UINT8_C(0x12)
#define IIM42652_GYRO_CONFIG_STATIC10 UINT8_C(0x13)
#define IIM42652_XG_ST_DATA UINT8_C(0x5F)
#define IIM42652_YG_ST_DATA UINT8_C(0x60)
#define IIM42652_ZG_ST_DATA UINT8_C(0x61)
#define IIM42652_TMSTVAL0 UINT8_C(0x62)
#define IIM42652_TMSTVAL1 UINT8_C(0x63)
#define IIM42652_TMSTVAL2 UINT8_C(0x64)
#define IIM42652_INTF_CONFIG4 UINT8_C(0x7A)
#define IIM42652_INTF_CONFIG5 UINT8_C(0x7B)
#define IIM42652_INTF_CONFIG6 UINT8_C(0x7C)

// Registers bank 2
#define IIM42652_ACCEL_CONFIG_STATIC2 UINT8_C(0x03)
#define IIM42652_ACCEL_CONFIG_STATIC3 UINT8_C(0x04)
#define IIM42652_ACCEL_CONFIG_STATIC4 UINT8_C(0x05)
#define IIM42652_XA_ST_DATA UINT8_C(0x3B)
#define IIM42652_YA_ST_DATA UINT8_C(0x3C)
#define IIM42652_ZA_ST_DATA UINT8_C(0x3D)

// Registers bank 3
#define IIM42652_PU_PD_CONFIG1 UINT8_C(0x06)
#define IIM42652_PU_PD_CONFIG2 UINT8_C(0x0E)

// Registers bank 4
#define IIM42652_FDR_CONFIG UINT8_C(0x09)
#define IIM42652_APEX_CONFIG1 UINT8_C(0x40)
#define IIM42652_APEX_CONFIG2 UINT8_C(0x41)
#define IIM42652_APEX_CONFIG3 UINT8_C(0x42)
#define IIM42652_APEX_CONFIG4 UINT8_C(0x43)
#define IIM42652_APEX_CONFIG5 UINT8_C(0x44)
#define IIM42652_APEX_CONFIG6 UINT8_C(0x45)
#define IIM42652_APEX_CONFIG7 UINT8_C(0x46)
#define IIM42652_APEX_CONFIG8 UINT8_C(0x47)
#define IIM42652_APEX_CONFIG9 UINT8_C(0x48)
#define IIM42652_APEX_CONFIG10 UINT8_C(0x49)
#define IIM42652_ACCEL_WOM_X_THR UINT8_C(0x4A)
#define IIM42652_ACCEL_WOM_Y_THR UINT8_C(0x4B)
#define IIM42652_ACCEL_WOM_Z_THR UINT8_C(0x4C)
#define IIM42652_INT_SOURCE6 UINT8_C(0x4D)
#define IIM42652_INT_SOURCE7 UINT8_C(0x4E)
#define IIM42652_INT_SOURCE8 UINT8_C(0x4F)
#define IIM42652_INT_SOURCE9 UINT8_C(0x50)
#define IIM42652_INT_SOURCE10 UINT8_C(0x51)
#define IIM42652_OFFSET_USER0 UINT8_C(0x77)
#define IIM42652_OFFSET_USER1 UINT8_C(0x78)
#define IIM42652_OFFSET_USER2 UINT8_C(0x79)
#define IIM42652_OFFSET_USER3 UINT8_C(0x7A)
#define IIM42652_OFFSET_USER4 UINT8_C(0x7B)
#define IIM42652_OFFSET_USER5 UINT8_C(0x7C)
#define IIM42652_OFFSET_USER6 UINT8_C(0x7D)
#define IIM42652_OFFSET_USER7 UINT8_C(0x7E)
#define IIM42652_OFFSET_USER8 UINT8_C(0x7F)

/**REGISTER SETTINGS**************************/
// register banks
#define IIM42652_REG_BANK_0 UINT8_C(0x00)
#define IIM42652_REG_BANK_1 UINT8_C(0x01)
#define IIM42652_REG_BANK_2 UINT8_C(0x02)
#define IIM42652_REG_BANK_3 UINT8_C(0x03)
#define IIM42652_REG_BANK_4 UINT8_C(0x04)
// ODR
#define IIM42652_ODR_32KHZ UINT8_C(0x01)
#define IIM42652_ODR_16KHZ UINT8_C(0x02)
#define IIM42652_ODR_8KHZ UINT8_C(0x03)
#define IIM42652_ODR_4KHZ UINT8_C(0x04)
#define IIM42652_ODR_2KHZ UINT8_C(0x05)
#define IIM42652_ODR_1KHZ UINT8_C(0x06)
#define IIM42652_ODR_500HZ UINT8_C(0x0F)
#define IIM42652_ODR_200HZ UINT8_C(0x07)
#define IIM42652_ODR_100HZ UINT8_C(0x08)
#define IIM42652_ODR_50HZ UINT8_C(0x09)
#define IIM42652_ODR_25HZ UINT8_C(0x0A)
#define IIM42652_ODR_12_5HZ UINT8_C(0x0B)
#define IIM42652_ODR_6_25HZ UINT8_C(0x0C)   // only available for accelerometer, not for gyro
#define IIM42652_ODR_3_125HZ UINT8_C(0x0D)  // only available for accelerometer, not for gyro
#define IIM42652_ODR_1_5625HZ UINT8_C(0x0E) // only available for accelerometer, not for gyro

// range accelerometer
#define IIM42652_RANGE_PM16G UINT8_C(0x00)
#define IIM42652_RANGE_PM8G UINT8_C(0x01)
#define IIM42652_RANGE_PM4G UINT8_C(0x02)
#define IIM42652_RANGE_PM2G UINT8_C(0x03)

// range gyro
#define IIM42652_RANGE_PM2kdps UINT8_C(0x00)
#define IIM42652_RANGE_PM1kdps UINT8_C(0x01)
#define IIM42652_RANGE_PM500dps UINT8_C(0x02)
#define IIM42652_RANGE_PM250dps UINT8_C(0x03)
#define IIM42652_RANGE_PM125dps UINT8_C(0x04)
#define IIM42652_RANGE_PM62_5dps UINT8_C(0x05)
#define IIM42652_RANGE_PM31_25dps UINT8_C(0x06)
#define IIM42652_RANGE_PM15_625dps UINT8_C(0x07)

// fifo mode
#define IIM42652_FIFO_BYPASS UINT8_C(0x00)
#define IIM42652_STREAM_TO_FIFO UINT8_C(0x01)
#define IIM42652_STREAM_TO_FIFO_STOP_ON_FULL UINT8_C(0x10)
```

## inc/sensors.h
```c
#pragma once

void sensor_task(void);
```

## inc/stts2004.h
```c
#pragma once

extern int STTS2004_temperature(double *temp);
```

## src/adc.c
```c
#include "adc.h"
#include <zephyr/kernel.h>
#include <zephyr/drivers/adc.h>
#include <hal/nrf_saadc.h>
#include <zephyr/sys/printk.h>

#define ADC_NODE DT_NODELABEL(adc)
#define ADC_CHANNEL_ID 5
#define ADC_RESOLUTION 12
#define ADC_GAIN ADC_GAIN_1_6
#define ADC_REFERENCE ADC_REF_INTERNAL
#define ADC_ACQUISITION_TIME ADC_ACQ_TIME_DEFAULT

static const struct device *adc_dev = NULL;

int adc_init(void)
{
    adc_dev = DEVICE_DT_GET(ADC_NODE);
    if (!device_is_ready(adc_dev))
    {
        printk("ADC device not ready\n");
        return -ENODEV;
    }

    struct adc_channel_cfg channel_cfg = {
        .gain = ADC_GAIN,
        .reference = ADC_REFERENCE,
        .acquisition_time = ADC_ACQUISITION_TIME,
        .channel_id = ADC_CHANNEL_ID,
        .differential = 0,
        .input_positive = NRF_SAADC_INPUT_AIN5, // Only if needed for your SoC
    };

    int ret = adc_channel_setup(adc_dev, &channel_cfg);
    if (ret)
    {
        printk("ADC channel setup failed (%d)\n", ret);
        return ret;
    }
    return 0;
}

int adc_measure(double *voltage)
{
    if (!adc_dev)
    {
        printk("ADC not initialized\n");
        return -ENODEV;
    }

    int16_t buf;
    struct adc_sequence sequence = {
        .channels = BIT(ADC_CHANNEL_ID),
        .buffer = &buf,
        .buffer_size = sizeof(buf),
        .resolution = ADC_RESOLUTION,
    };

    int ret = adc_read(adc_dev, &sequence);
    if (ret)
    {
        printk("ADC read failed (%d)\n", ret);
        return ret;
    }

    const double vref = 0.6 * 6.0; // Vref  = 0.6 Gain = 1/6, adjust as needed
    *voltage = ((double)buf / (1 << ADC_RESOLUTION)) * vref;
    return 0;
}
```

## src/ble_nus.c
```c
#include "ble_nus.h"
#include <zephyr/kernel.h>
#include <zephyr/bluetooth/bluetooth.h>
#include <zephyr/bluetooth/services/nus.h>
#include <zephyr/sys/printk.h>
#include <zephyr/sys/util.h>
#include <stdarg.h>

#define DEVICE_NAME CONFIG_BT_DEVICE_NAME
#define DEVICE_NAME_LEN (sizeof(DEVICE_NAME) - 1)

#define DEVICE_NAME CONFIG_BT_DEVICE_NAME
#define DEVICE_NAME_LEN (sizeof(DEVICE_NAME) - 1)

void notif_enabled(bool enabled, void *ctx);
void received(struct bt_conn *conn, const void *data, uint16_t len, void *ctx);
void connected(struct bt_conn *conn, uint8_t err);
void disconnected(struct bt_conn *conn, uint8_t reason);

static const struct bt_data ad[] = {
    BT_DATA_BYTES(BT_DATA_FLAGS, (BT_LE_AD_GENERAL | BT_LE_AD_NO_BREDR)),
    BT_DATA(BT_DATA_NAME_COMPLETE, DEVICE_NAME, DEVICE_NAME_LEN),
};

static const struct bt_data sd[] = {
    BT_DATA_BYTES(BT_DATA_UUID128_ALL, BT_UUID_NUS_SRV_VAL),
};

static struct bt_conn *current_conn = NULL;

struct bt_nus_cb nus_listener = {
    .notif_enabled = notif_enabled,
    .received = received,
};

static struct bt_conn_cb conn_callbacks = {
    .connected = connected,
    .disconnected = disconnected,
};

static void adv_restart(struct k_work *work);
static struct k_work_delayable adv_restart_work;

struct bt_conn *ble_connection(void)
{
    return current_conn;
}

int ble_init()
{
    int err;
    err = bt_nus_cb_register(&nus_listener, NULL);
    if (err)
    {
        printk("Failed to register NUS callback: %d\n", err);
        return err;
    }

    bt_conn_cb_register(&conn_callbacks);

    err = bt_enable(NULL);
    if (err)
    {
        printk("Failed to enable bluetooth: %d\n", err);
        return err;
    }

    err = bt_le_adv_start(BT_LE_ADV_CONN_FAST_1, ad, ARRAY_SIZE(ad), sd, ARRAY_SIZE(sd));
    if (err)
    {
        printk("Failed to start advertising: %d\n", err);
        return err;
    }

    k_work_init_delayable(&adv_restart_work, adv_restart);

    return 0;
}
void notif_enabled(bool enabled, void *ctx)
{
    ARG_UNUSED(ctx);

    printk("%s() - %s\n", __func__, (enabled ? "Enabled" : "Disabled"));
}

void received(struct bt_conn *conn, const void *data, uint16_t len, void *ctx)
{
    char message[CONFIG_BT_L2CAP_TX_MTU + 1] = "";

    ARG_UNUSED(ctx);

    memcpy(message, data, MIN(sizeof(message) - 1, len));
    printk("%s() - Len: %d, Message: %s\n", __func__, len, message);

    // Echo received data back to the central
    int err = bt_nus_send(current_conn, message, strlen(message));
    printk("Echoed data back - Result: %d\n", err);
}

void connected(struct bt_conn *conn, uint8_t err)
{
    if (err)
    {
        printk("Connection failed (err %u)\n", err);
        return;
    }
    current_conn = bt_conn_ref(conn);
    printk("Central connected\n");
}

static void adv_restart(struct k_work *work)
{
    int err = bt_le_adv_start(BT_LE_ADV_CONN_FAST_1, ad, ARRAY_SIZE(ad), sd, ARRAY_SIZE(sd));
    if (err == -EADDRINUSE)
    {
        printk("Advertising busy, retrying...\n");
        k_work_schedule(&adv_restart_work, K_MSEC(300));
    }
    else if (err)
    {
        printk("Failed to restart advertising: %d\n", err);
        // Optionally, retry on other errors as well
        k_work_schedule(&adv_restart_work, K_MSEC(1000));
    }
    else
    {
        printk("Advertising restarted\n");
    }
}

void disconnected(struct bt_conn *conn, uint8_t reason)
{
    if (current_conn)
    {
        bt_conn_unref(current_conn);
        current_conn = NULL;
    }
    printk("Central disconnected (reason %u)\n", reason);

    // Schedule advertising restart after a short delay
    k_work_schedule(&adv_restart_work, K_MSEC(300));
}

// Printf-like function to send a formatted message over Bluetooth NUS
int bt_nus_printf(const char *fmt, ...)
{
    struct bt_conn *conn = ble_connection();
    if (!conn)
    {
        return -ENOTCONN;
    }
    char buf[512];
    va_list args;
    va_start(args, fmt);
    int len = vsnprintk(buf, sizeof(buf), fmt, args);
    va_end(args);

    if (len < 0)
    {
        return len;
    }
    // Ensure null-termination for safety, though bt_nus_send uses length
    buf[sizeof(buf) - 1] = '\0';

    int total_sent = 0;
    const int chunk_size = 253;
    for (int offset = 0; offset < len; offset += chunk_size)
    {
        int send_len = (len - offset > chunk_size) ? chunk_size : (len - offset);
        int rc = bt_nus_send(conn, &buf[offset], send_len);
        if (rc < 0)
        {
            return rc;
        }
        total_sent += send_len;
    }
    return total_sent;
}
```

## src/board.c
```c
#include "board.h"
#include <zephyr/kernel.h>
#include <zephyr/drivers/gpio.h>

#define ZEPHYR_USER_NODE DT_PATH(zephyr_user)
const struct gpio_dt_spec vddpctrl =
    GPIO_DT_SPEC_GET(ZEPHYR_USER_NODE, vddpctrl_gpios);

void brt_vddp_ctrl(bool on)
{
    // Control the VDDP pin based on the 'on' parameter
    if (on)
    {
        gpio_pin_set_dt(&vddpctrl, 1);
        printk("VDDP control pin set to ON.\n");
    }
    else
    {
        gpio_pin_set_dt(&vddpctrl, 0);
        printk("VDDP control pin set to OFF.\n");
    }
}
void brd_init(void)
{

    // Initialize the board-specific hardware and peripherals here
    // This function is called during the system initialization phase
    gpio_pin_configure_dt(&vddpctrl, GPIO_OUTPUT_INACTIVE);
    gpio_pin_set_dt(&vddpctrl, 1); // Set VDDP control pin to low initially

    printk("Board initialized successfully.\n");
}
```

## src/iim42652.c
```c
#include "iim42652.h"
#include <zephyr/drivers/spi.h>
#define SPI1_NODE DT_NODELABEL(spi1)

const struct device *spi1 = DEVICE_DT_GET(SPI1_NODE);

typedef struct
{
    bool initialized;
    bool data_valid;
} iim42652_instance_t;

iim42652_instance_t iim42652_instance = {
    .initialized = false,
    .data_valid = false,
};

uint8_t IIM42652_read_register(uint8_t reg)
{

    uint8_t tx_buf[2] = {reg | 0x80, 0}; // Read command with MSB set
    uint8_t rx_buf[2] = {0};             // Buffer to store received data
    struct spi_buf tx = {
        .buf = tx_buf,
        .len = sizeof(tx_buf),
    };
    struct spi_buf rx = {
        .buf = rx_buf,
        .len = sizeof(rx_buf),
    };
    struct spi_buf_set tx_set = {
        .buffers = &tx,
        .count = 1,
    };
    struct spi_buf_set rx_set = {
        .buffers = &rx,
        .count = 1,
    };
    struct spi_config spi_cfg = {
        .frequency = 1000000U, // 1 MHz, adjust as needed
        .operation = SPI_OP_MODE_MASTER | SPI_WORD_SET(8) | SPI_TRANSFER_MSB,
        .slave = 0,
        .cs = {
            .gpio = GPIO_DT_SPEC_GET(SPI1_NODE, cs_gpios),
        },
    };
    int rc = spi_transceive(spi1, &spi_cfg, &tx_set, &rx_set);
    if (rc < 0)
    {
        return 0; // Return an error value
    }
    return rx_buf[1]; // Return the read value
}

void IIM42652_write_register(uint8_t reg, uint8_t value)
{

    uint8_t tx_buf[2] = {reg & 0x7F, value}; // Write command with MSB cleared
    struct spi_buf tx = {
        .buf = tx_buf,
        .len = sizeof(tx_buf),
    };
    struct spi_buf_set tx_set = {
        .buffers = &tx,
        .count = 1,
    };
    struct spi_config spi_cfg = {
        .frequency = 1000000U, // 1 MHz, adjust as needed
        .operation = SPI_OP_MODE_MASTER | SPI_WORD_SET(8) | SPI_TRANSFER_MSB,
        .slave = 0,
        .cs = {
            .gpio = GPIO_DT_SPEC_GET(SPI1_NODE, cs_gpios),
        },
    };
    int rc = spi_write(spi1, &spi_cfg, &tx_set);
    if (rc < 0)
    {
        printk("SPI write failed: %d\n", rc);
        bt_nus_printf("SPI write failed: %d\n", rc);
    }
}
void IIM42652_init(void)
{
    if (!device_is_ready(spi1))
    {
        iim42652_instance.initialized = false;
        iim42652_instance.data_valid = false;
        return;
    }

    uint8_t cfg = IIM42652_read_register(IIM42652_DEVICE_CONFIG);
    if (cfg == 0xFF) // Check if the device is not responding
    {
        iim42652_instance.initialized = false;
        iim42652_instance.data_valid = false;
        return;
    }
    // Initialize IIM42652 with default settings
    IIM42652_write_register(IIM42652_DEVICE_CONFIG, cfg | 0x01); // Example: Set configuration register to a known state // Example: Set another register to a known state
                                                                 // delay for sensor initialization
    k_sleep(K_MSEC(100));

    uint8_t setting = 0x0c | 0x03;                        // LN mode, set gyro and accel to LN mode
    IIM42652_write_register(IIM42652_PWR_MGMT0, setting); // Example: Enable accelerometer

    iim42652_instance.initialized = true;
    iim42652_instance.data_valid = false;
}

int IIM42652_data(iim42652_data_t *iim_data)
{

    if (!iim42652_instance.initialized)
    {
        IIM42652_init();
        if (!iim42652_instance.initialized)
        {
            return -1; // Initialization failed
        }
        // Return an error code
    }
    uint8_t rx_data[1 + 2 + 6 + 6] = {0}; // Temp 2 bytes Acc 6 bytes Gyro 6 bytes
    uint8_t tx_data = IIM42652_TEMP_DATA1_UI | 0x80;
    // Read accelerometer data from IIM42652
    struct spi_buf tx_buf = {
        .buf = &tx_data, // No data to send
        .len = 1,
    };
    struct spi_buf rx_buf = {
        .buf = rx_data,
        .len = sizeof(rx_data),
    };
    struct spi_buf_set tx = {
        .buffers = &tx_buf,
        .count = 1,
    };
    struct spi_buf_set rx = {
        .buffers = &rx_buf,
        .count = 1,
    };
    struct spi_config spi_cfg = {
        .frequency = 1000000U, // 1 MHz, adjust as needed
        .operation = SPI_OP_MODE_MASTER | SPI_WORD_SET(8) | SPI_TRANSFER_MSB,
        .slave = 0,
        .cs = {
            .gpio = GPIO_DT_SPEC_GET(SPI1_NODE, cs_gpios),
        },
    };
    int rc = spi_transceive(spi1, &spi_cfg, &tx, &rx);
    if (rc < 0)
    {
        iim42652_instance.initialized = false;
        iim42652_instance.data_valid = false;
        return -1; // SPI transfer failed
    }

    // assuming the data is in the format:
    // [Temp MSB, Temp LSB, Accel X MSB, Accel X LSB, Accel Y MSB, Accel Y LSB, Accel Z MSB, Accel Z LSB,
    // Gyro X MSB, Gyro X LSB, Gyro Y MSB, Gyro Y LSB, Gyro Z MSB, Gyro Z LSB]
    uint8_t temp_msb = rx_data[1];
    uint8_t temp_lsb = rx_data[2];
    uint8_t *accel_data = rx_data + 1 + 2;    // Skip the first byte (command byte)
    uint8_t *gyro_data = rx_data + 1 + 2 + 6; // Skip the first byte (command byte) and temperature bytes

    // Convert temperature using formula: (TEMP_DATA / 132.48) + 25
    int16_t temp_raw = (int16_t)((temp_msb << 8) | temp_lsb);
    iim_data->temp = ((double)temp_raw / 132.48) + 25.0; // Correct temperature conversion

    // Process accelerometer data
    iim_data->acc[0] = (double)((int16_t)((accel_data[0] << 8) | accel_data[1])) / 2048.0; // Convert to g
    iim_data->acc[1] = (double)((int16_t)((accel_data[2] << 8) | accel_data[3])) / 2048.0; // Convert to g
    iim_data->acc[2] = (double)((int16_t)((accel_data[4] << 8) | accel_data[5])) / 2048.0; // Convert to g

    // Process gyroscope data
    iim_data->gyro[0] = (double)((int16_t)((gyro_data[0] << 8) | gyro_data[1])) / 16.4; // Convert to dps
    iim_data->gyro[1] = (double)((int16_t)((gyro_data[2] << 8) | gyro_data[3])) / 16.4; // Convert to dps
    iim_data->gyro[2] = (double)((int16_t)((gyro_data[4] << 8) | gyro_data[5])) / 16.4; // Convert to dps

    return 0;
}
```

## src/sensors.c
```c
void sensor_task(void)
{
}
```

## src/stts2004.c
```c
#include <zephyr/drivers/i2c.h>
#define STTS2004_I2C_TEMPERATURE_ADDRESS 0x18
#define I2C0_NODE DT_NODELABEL(i2c0)
const struct device *i2c0 = DEVICE_DT_GET(I2C0_NODE);
typedef struct
{
    bool initialized;
    bool data_valid;
    double temperature;
} stts2004_instance_t;

stts2004_instance_t stts2004_instance;

double STTS2004_calculate_temperature(uint16_t raw_temp)
{
    // Convert the raw temperature value to Celsius
    // Adjust the conversion factor as per the sensor's datashee
    int16_t tmp;
    tmp = (raw_temp & 0x1000) ? -(raw_temp & 0x0FFF) : (raw_temp & 0x0FFF); // Sign extend for negative temperatures

    return ((double)tmp) * 0.0625; // Example conversion factor, adjust as needed
}
void stt2004_init()
{
    if (!device_is_ready(i2c0))
    {
        stts2004_instance.initialized = false;
        stts2004_instance.data_valid = false;
        return;
    }

    stts2004_instance.initialized = true;
}
void stt2004_update()
{
    uint8_t reg = 0x05; // Command to read temperature, adjust as needed
    uint8_t reg_value[2] = {0};
    struct i2c_msg msgs[] = {
        {
            .buf = &reg,
            .len = 1,
            .flags = I2C_MSG_WRITE | I2C_MSG_STOP,
        },
        {
            .buf = reg_value,
            .len = 2,
            .flags = I2C_MSG_READ | I2C_MSG_STOP,
        },

    };
    int rc = i2c_transfer(i2c0, msgs, 2, STTS2004_I2C_TEMPERATURE_ADDRESS);

    if (rc < 0)
    {
        stts2004_instance.data_valid = false;
        stts2004_instance.initialized = false;
        return;
    }
    double temperature = STTS2004_calculate_temperature((reg_value[0] << 8) | reg_value[1]); // Convert to Celsius, adjust scaling as needed
    stts2004_instance.temperature = temperature;
    stts2004_instance.data_valid = true;
}
int STTS2004_temperature(double *temp)
{

    if (!stts2004_instance.initialized)
    {
        stt2004_init();
    }

    stt2004_update();
    if (!stts2004_instance.data_valid)
    {
        return -1; // Error: Data not valid
    }
    *temp = stts2004_instance.temperature;
    return 0; // Success
};
```
