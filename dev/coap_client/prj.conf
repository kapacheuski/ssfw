## CMakeLists.txt
```
cmake_minimum_required(VERSION 3.20.0)

find_package(Zephyr REQUIRED HINTS $ENV{ZEPHYR_BASE})

project(coap_client)

# NORDIC SDK APP START
target_sources(app PRIVATE src/coap_client.c
			   src/coap_client_utils.c
			   src/dns_utils.c
			   src/net_utils.c
			   src/ble_utils.c)

target_include_directories(app PUBLIC coap_server/interface
			   inc
			   src)




			   # NORDIC SDK APP END
```

## prj.conf
```kconfig
# Increase Settings storage size
CONFIG_PM_PARTITION_SIZE_SETTINGS_STORAGE=0x8000

CONFIG_MBEDTLS_SHA1_C=n
CONFIG_FPU=y

# Generic networking options
CONFIG_NETWORKING=y
CONFIG_NET_SOCKETS=y
CONFIG_NET_SOCKETS_POLL_MAX=4

# L2 OpenThread enabling
CONFIG_NET_L2_OPENTHREAD=y

# Enable OpenThread
CONFIG_OPENTHREAD=y
CONFIG_OPENTHREAD_SLAAC=y
CONFIG_OPENTHREAD_MTD=y
CONFIG_OPENTHREAD_SRP_CLIENT=y
CONFIG_OPENTHREAD_DNS_CLIENT=y

# Thread Operational Dataset
CONFIG_OPENTHREAD_PANID=4660
CONFIG_OPENTHREAD_XPANID="11:11:11:11:22:22:22:22"
CONFIG_OPENTHREAD_NETWORKKEY="00:11:22:33:44:55:66:77:88:99:aa:bb:cc:dd:ee:ff"
CONFIG_OPENTHREAD_CHANNEL=15
CONFIG_OPENTHREAD_NETWORK_NAME="OpenThreadDemo"

# Enable CoAP utils and CoAP protocol
CONFIG_COAP=y
CONFIG_COAP_UTILS=y

# BLE Configuration
CONFIG_BT_L2CAP_TX_MTU=263
CONFIG_BT_BUF_ACL_RX_SIZE=267
CONFIG_BT_BUF_ACL_TX_SIZE=267
# Ring buffer support
CONFIG_RING_BUFFER=y
# Increase system heap for ring buffer
CONFIG_HEAP_MEM_POOL_SIZE=4096




# ----------------------------------------------------
# Config for USB Logger.
# ----------------------------------------------------

# # USB
# CONFIG_STDOUT_CONSOLE=y
# CONFIG_USB_DEVICE_STACK=y
# CONFIG_USB_DEVICE_PRODUCT="Zephyr CDC ACM sample"
# CONFIG_USB_DEVICE_PID=0x0001
# CONFIG_USB_DEVICE_INITIALIZE_AT_BOOT=n

# # Serial
# CONFIG_SERIAL=y
# CONFIG_CONSOLE=y
# CONFIG_UART_CONSOLE=y
# CONFIG_UART_INTERRUPT_DRIVEN=y
# CONFIG_UART_LINE_CTRL=y

# # Logger
# CONFIG_LOG=y
# CONFIG_USB_DRIVER_LOG_LEVEL_ERR=y
# CONFIG_USB_DEVICE_LOG_LEVEL_ERR=y

# CONFIG_LOG_BACKEND_UART=y
# CONFIG_LOG_MODE_IMMEDIATE=y
```

## inc/ble_utils.h
```c
/**
 * @file
 * @defgroup ble_utils Bluetooth LE utilities API
 * @{
 */

/*
 * Copyright (c) 2020 Nordic Semiconductor ASA
 *
 * SPDX-License-Identifier: LicenseRef-Nordic-5-Clause
 */

#ifndef __BLE_UTILS_H__
#define __BLE_UTILS_H__

#include <bluetooth/services/nus.h>

/** @brief Type indicates function called when Bluetooth LE connection
 *         is established.
 *
 * @param[in] item pointer to work item.
 */
typedef void (*ble_connection_cb_t)(struct k_work *item);

/** @brief Type indicates function called when Bluetooth LE connection is ended.
 *
 * @param[in] item pointer to work item.
 */
typedef void (*ble_disconnection_cb_t)(struct k_work *item);

/** @brief Initialize CoAP utilities.
 *
 * @param[in] on_nus_received function to call when NUS receives message
 * @param[in] on_nus_send     function to call when NUS sends message
 * @param[in] on_connect      function to call when Bluetooth LE connection
 *                            is established
 * @param[in] on_disconnect   function to call when Bluetooth LE connection
 *                            is ended
 * @retval 0    On success.
 * @retval != 0 On failure.
 */
int ble_utils_init(struct bt_nus_cb *nus_clbs,
				   ble_connection_cb_t on_connect,
				   ble_disconnection_cb_t on_disconnect);

int bt_nus_printf(const char *fmt, ...);

/** @brief ISR-safe version of bt_nus_printf that can be called from any context.
 *
 * @param[in] buffer    Pre-formatted string buffer to send
 * @param[in] len       Length of the buffer
 * @retval 0    On success.
 * @retval != 0 On failure.
 */
int bt_nus_printf_buffer(const char *buffer, size_t len);

/** @brief Ultra-safe printf for callback contexts (minimal formatting).
 *
 * @param[in] msg    Simple message string to send
 * @retval 0    On success.
 * @retval != 0 On failure.
 */
int bt_nus_printf_safe(const char *msg);

/** @brief Get ring buffer statistics for debugging.
 *
 * @param[out] used_bytes   Number of bytes currently used in ring buffer
 * @param[out] free_bytes   Number of bytes available in ring buffer
 * @param[out] total_bytes  Total ring buffer size
 */
void ble_utils_get_ring_buffer_stats(uint32_t *used_bytes, uint32_t *free_bytes, uint32_t *total_bytes);

/** @brief Clear the ring buffer (flush all pending messages).
 */
void ble_utils_clear_ring_buffer(void);

/**
 * @brief Usage example:
 *
 * // Initialize BLE utils with NUS callbacks
 * struct bt_nus_cb nus_callbacks = { ... };
 * ble_utils_init(&nus_callbacks, on_connect_handler, on_disconnect_handler);
 *
 * // Send messages using bt_nus_printf (messages will be queued in ring buffer)
 * bt_nus_printf("Hello BLE World!\n");
 * bt_nus_printf("Temperature: %d.%d°C\n", temp_int, temp_frac);
 *
 * // Check ring buffer status for debugging
 * uint32_t used, free, total;
 * ble_utils_get_ring_buffer_stats(&used, &free, &total);
 * printk("Ring buffer: %d/%d bytes used\n", used, total);
 *
 * // Clear buffer if needed
 * ble_utils_clear_ring_buffer();
 */

#endif

/**
 * @}
 */
```

## inc/coap_client_utils.h
```c
/**
 * @file
 * @defgroup coap_client_utils API for coap_client_* samples
 * @{
 */

/*
 * Copyright (c) 2020 Nordic Semiconductor ASA
 *
 * SPDX-License-Identifier: LicenseRef-Nordic-5-Clause
 */

#ifndef __COAP_CLIENT_UTILS_H__
#define __COAP_CLIENT_UTILS_H__

/** @brief Type indicates function called when OpenThread connection
 *         is established.
 *
 * @param[in] item pointer to work item.
 */
typedef void (*ot_connection_cb_t)(struct k_work *item);

/** @brief Type indicates function called when OpenThread connection is ended.
 *
 * @param[in] item pointer to work item.
 */
typedef void (*ot_disconnection_cb_t)(struct k_work *item);

/** @brief Type indicates function called when the MTD modes are toggled.
 *
 * @param[in] val 1 if the MTD is in MED mode
 *                0 if the MTD is in SED mode
 */
typedef void (*mtd_mode_toggle_cb_t)(uint32_t val);

/** @brief Initialize CoAP client utilities.
 */
void coap_client_utils_init(ot_connection_cb_t on_connect,
							ot_disconnection_cb_t on_disconnect,
							mtd_mode_toggle_cb_t on_toggle);

/** @brief Toggle light on the CoAP server node.
 *
 * @note The CoAP server should be paired before to have an affect.
 */
void coap_client_toggle_one_light(void);

/** @brief Toggle lights on all CoAP servers in the network mesh.
 */
void coap_client_toggle_mesh_lights(void);

/** @brief Request for the CoAP server address to pair.
 *
 * @note Enable paring on the CoAP server to get the address.
 */
void coap_client_send_provisioning_request(void);

void coap_client_get_time(void);

/** @brief Request time from a specific address.
 *
 * @param[in] server_addr The IPv6 address to request time from
 */
void coap_client_get_time_from_address(const struct sockaddr_in6 *server_addr);

/** @brief Toggle SED to MED and MED to SED modes.
 *
 * @note Active when the device is working as Minimal Thread Device.
 */
void coap_client_toggle_minimal_sleepy_end_device(void);

int coap_send_ipv4_message(const char *server_ip, uint16_t server_port,
						   const char *const *path,
						   uint8_t *payload, size_t payload_len,
						   uint8_t method);

#endif

/**
 * @}
 */
```

## inc/dns_utils.h
```c
#ifndef DNS_UTILS_H
#define DNS_UTILS_H

#include <stdbool.h>

/**
 * DNS resolution result callback
 * @param result 0 on success, negative error code on failure
 * @param addr Resolved IPv6 address (NULL on failure)
 */
typedef void (*dns_resolve_callback_t)(int result, struct sockaddr_in6 *addr);

/**
 * Initialize DNS utilities
 */
void dns_utils_init(void);

/**
 * Start DNS resolution for a hostname (asynchronous)
 * @param hostname The hostname to resolve
 * @param callback Callback function to call when resolution completes
 * @return 0 on success, negative error code on failure
 */
int dns_resolve_async(const char *hostname, dns_resolve_callback_t callback);

/**
 * Start DNS resolution for the default server hostname
 * @param callback Callback function to call when resolution completes
 * @return 0 on success, negative error code on failure
 */
int dns_resolve_default_server(dns_resolve_callback_t callback);

/**
 * Check if DNS resolution is complete
 * @return true if complete, false if still in progress
 */
bool dns_is_resolution_complete(void);

/**
 * Get the resolved address (only valid after successful resolution)
 * @param addr Pointer to store the resolved address
 * @return 0 on success, negative error code if not resolved
 */
int dns_get_resolved_address(struct sockaddr_in6 *addr);

/**
 * Synchronous DNS resolution (blocks until complete)
 * @param hostname The hostname to resolve
 * @param addr Pointer to store the resolved address
 * @param timeout_ms Timeout in milliseconds
 * @return 0 on success, negative error code on failure
 */
int dns_resolve_sync(const char *hostname, struct sockaddr_in6 *addr, int timeout_ms);

void coap_client_resolve_hostname(const char *hostname);

/**
 * Get the resolved address if available
 * @param addr Pointer to store the resolved IPv6 address
 * @return 0 on success (address available), negative error code on failure
 */
int coap_client_get_resolved_address(struct sockaddr_in6 *addr);

/**
 * Check if an address has been resolved
 * @return true if address is available, false otherwise
 */
bool coap_client_is_address_resolved(void);

/**
 * Clear the resolved address (useful for starting fresh)
 */
void coap_client_clear_resolved_address(void);

#endif // DNS_UTILS_H
```

## inc/net_utils.h
```c
#ifndef NET_UTILS_H
#define NET_UTILS_H

#include <zephyr/kernel.h>
#include <zephyr/net/net_if.h>

/**
 * Display OpenThread Network Data
 */
void display_openthread_netdata(void);

/**
 * Display network data in raw format
 */
void display_raw_netdata(void);

/**
 * Display Thread network topology information
 */
void display_thread_topology(void);

/**
 * Display Thread operational dataset information
 */
void display_operational_dataset(void);

/**
 * Display current DNS configuration
 */
void display_dns_config(void);

/**
 * Command to display all network information
 */
void cmd_show_netdata(void);

#endif /* NET_UTILS_H */
```

## src/ble_utils.c
```c
/*
 * Copyright (c) 2020 Nordic Semiconductor ASA
 *
 * SPDX-License-Identifier: LicenseRef-Nordic-5-Clause
 */

#include <zephyr/kernel.h>
#include <zephyr/bluetooth/gatt.h>
#include <zephyr/bluetooth/hci.h>
#include <zephyr/bluetooth/uuid.h>
#include <zephyr/logging/log.h>
#include <zephyr/settings/settings.h>
#include <zephyr/sys/ring_buffer.h>

#include "ble_utils.h"

LOG_MODULE_REGISTER(ble_utils, CONFIG_BLE_UTILS_LOG_LEVEL);

#define DEVICE_NAME CONFIG_BT_DEVICE_NAME
#define DEVICE_NAME_LEN (sizeof(DEVICE_NAME) - 1)

// Ring buffer configuration
#ifndef CONFIG_BLE_MSG_RING_BUF_SIZE
#define BLE_MSG_RING_BUF_SIZE 2048
#else
#define BLE_MSG_RING_BUF_SIZE CONFIG_BLE_MSG_RING_BUF_SIZE
#endif

#ifndef CONFIG_BLE_MSG_MAX_SIZE
#define BLE_MSG_MAX_SIZE 512
#else
#define BLE_MSG_MAX_SIZE CONFIG_BLE_MSG_MAX_SIZE
#endif

#ifndef CONFIG_BLE_THREAD_STACK_SIZE
#define BLE_THREAD_STACK_SIZE 1024
#else
#define BLE_THREAD_STACK_SIZE CONFIG_BLE_THREAD_STACK_SIZE
#endif

#ifndef CONFIG_BLE_THREAD_PRIORITY
#define BLE_THREAD_PRIORITY 5
#else
#define BLE_THREAD_PRIORITY CONFIG_BLE_THREAD_PRIORITY
#endif

// Ring buffer for BLE messages
static uint8_t ble_msg_ring_buf_data[BLE_MSG_RING_BUF_SIZE];
static struct ring_buf ble_msg_ring_buf;

// Thread for handling BLE messages
static K_THREAD_STACK_DEFINE(ble_thread_stack, BLE_THREAD_STACK_SIZE);
static struct k_thread ble_thread_data;
static k_tid_t ble_thread_tid;

// Semaphore to signal new messages in ring buffer
static K_SEM_DEFINE(ble_msg_sem, 0, 1);

static void connected(struct bt_conn *conn, uint8_t err);
static void disconnected(struct bt_conn *conn, uint8_t reason);
static void auth_passkey_display(struct bt_conn *conn, unsigned int passkey);
static void auth_cancel(struct bt_conn *conn);
static void pairing_complete(struct bt_conn *conn, bool bonded);
static void pairing_failed(struct bt_conn *conn, enum bt_security_err reason);
static void __attribute__((unused))
security_changed(struct bt_conn *conn, bt_security_t level,
				 enum bt_security_err err);

static struct bt_conn_auth_cb conn_auth_callbacks = {
	.passkey_display = auth_passkey_display,
	.cancel = auth_cancel,
};

static struct bt_conn_auth_info_cb conn_auth_info_callbacks = {
	.pairing_complete = pairing_complete,
	.pairing_failed = pairing_failed};

static struct bt_conn_cb conn_callbacks = {
	.connected = connected,
	.disconnected = disconnected,
	COND_CODE_1(CONFIG_BT_SMP, (.security_changed = security_changed), ())};

static const struct bt_data ad[] = {
	BT_DATA_BYTES(BT_DATA_FLAGS, (BT_LE_AD_GENERAL | BT_LE_AD_NO_BREDR)),
	BT_DATA(BT_DATA_NAME_COMPLETE, DEVICE_NAME, DEVICE_NAME_LEN),
};

static const struct bt_data sd[] = {
	BT_DATA_BYTES(BT_DATA_UUID128_ALL, BT_UUID_NUS_VAL),
};

static struct k_work on_connect_work;
static struct k_work on_disconnect_work;

static struct bt_conn *current_conn;

static void connected(struct bt_conn *conn, uint8_t err)
{
	if (err)
	{
		LOG_ERR("Connection failed (err %u)", err);
		return;
	}

	LOG_INF("Connected");
	current_conn = bt_conn_ref(conn);

	k_work_submit(&on_connect_work);
}

static void disconnected(struct bt_conn *conn, uint8_t reason)
{
	LOG_INF("Disconnected (reason %u)", reason);

	if (current_conn)
	{
		bt_conn_unref(current_conn);
		current_conn = NULL;

		// Clear any pending messages in the ring buffer when disconnected
		ble_utils_clear_ring_buffer();

		k_work_submit(&on_disconnect_work);
	}
}

static char *ble_addr(struct bt_conn *conn)
{
	static char addr[BT_ADDR_LE_STR_LEN];

	bt_addr_le_to_str(bt_conn_get_dst(conn), addr, sizeof(addr));

	return addr;
}

static void __attribute__((unused))
security_changed(struct bt_conn *conn, bt_security_t level,
				 enum bt_security_err err)
{
	char *addr = ble_addr(conn);

	if (!err)
	{
		LOG_INF("Security changed: %s level %u", addr, level);
	}
	else
	{
		LOG_INF("Security failed: %s level %u err %d", addr, level, err);
	}
}

static void auth_passkey_display(struct bt_conn *conn, unsigned int passkey)
{
	char *addr = ble_addr(conn);

	LOG_INF("Passkey for %s: %06u", addr, passkey);
}

static void auth_cancel(struct bt_conn *conn)
{
	char *addr = ble_addr(conn);

	LOG_INF("Pairing cancelled: %s", addr);
}

static void pairing_complete(struct bt_conn *conn, bool bonded)
{
	char *addr = ble_addr(conn);

	LOG_INF("Pairing completed: %s, bonded: %d", addr, bonded);
}

static void pairing_failed(struct bt_conn *conn, enum bt_security_err reason)
{
	char *addr = ble_addr(conn);

	LOG_INF("Pairing failed conn: %s, reason %d", addr, reason);
}

// BLE message sending thread
static void ble_thread_handler(void *arg1, void *arg2, void *arg3)
{
	ARG_UNUSED(arg1);
	ARG_UNUSED(arg2);
	ARG_UNUSED(arg3);

	uint8_t message_buffer[BLE_MSG_MAX_SIZE];
	uint16_t message_len;

	LOG_INF("BLE message thread started");

	while (1)
	{
		// Wait for semaphore indicating new message
		k_sem_take(&ble_msg_sem, K_FOREVER);

		// Process all messages in the ring buffer
		while (ring_buf_size_get(&ble_msg_ring_buf) > 0)
		{
			struct bt_conn *conn = current_conn;
			if (!conn)
			{
				// No connection, drain the ring buffer
				ring_buf_reset(&ble_msg_ring_buf);
				break;
			}

			// Get message length (first 2 bytes)
			if (ring_buf_get(&ble_msg_ring_buf, (uint8_t *)&message_len, sizeof(message_len)) != sizeof(message_len))
			{
				LOG_ERR("Failed to read message length from ring buffer");
				break;
			}

			// Validate message length
			if (message_len == 0 || message_len > BLE_MSG_MAX_SIZE)
			{
				LOG_ERR("Invalid message length: %d", message_len);
				break;
			}

			// Get message data
			if (ring_buf_get(&ble_msg_ring_buf, message_buffer, message_len) != message_len)
			{
				LOG_ERR("Failed to read message data from ring buffer");
				break;
			}

			// Send message in chunks
			const int chunk_size = 253;
			for (int offset = 0; offset < message_len; offset += chunk_size)
			{
				int send_len = (message_len - offset > chunk_size) ? chunk_size : (message_len - offset);
				int rc = bt_nus_send(conn, &message_buffer[offset], send_len);
				if (rc < 0)
				{
					LOG_ERR("BLE NUS send failed: %d", rc);
					break;
				}
				// Small delay between chunks to avoid overwhelming the BLE stack
				k_sleep(K_MSEC(20));
			}
		}
	}
}

// // Work handler for BLE printf (deprecated - keeping for compatibility)
// static void ble_printf_work_handler(struct k_work *item)
// {
// 	ARG_UNUSED(item);
// 	// This function is now deprecated as we use the thread-based approach
// 	LOG_WRN("Deprecated work handler called");
// }
int ble_utils_init(struct bt_nus_cb *nus_clbs, ble_connection_cb_t on_connect,
				   ble_disconnection_cb_t on_disconnect)
{
	int ret;

	k_work_init(&on_connect_work, on_connect);
	k_work_init(&on_disconnect_work, on_disconnect);

	bt_conn_cb_register(&conn_callbacks);

	if (IS_ENABLED(CONFIG_BT_SMP))
	{
		ret = bt_conn_auth_cb_register(&conn_auth_callbacks);
		if (ret)
		{
			LOG_ERR("Failed to register authorization callbacks.");
			goto end;
		}

		ret = bt_conn_auth_info_cb_register(&conn_auth_info_callbacks);
		if (ret)
		{
			LOG_ERR("Failed to register authorization info callbacks.");
			goto end;
		}
	}

	ret = bt_enable(NULL);
	if (ret)
	{
		LOG_ERR("Bluetooth initialization failed (error: %d)", ret);
		goto end;
	}

	LOG_INF("Bluetooth initialized");

	if (IS_ENABLED(CONFIG_SETTINGS))
	{
		settings_load();
	}

	ret = bt_nus_init(nus_clbs);
	if (ret)
	{
		LOG_ERR("Failed to initialize UART service (error: %d)", ret);
		goto end;
	}

	ret = bt_le_adv_start(BT_LE_ADV_CONN_FAST_2, ad, ARRAY_SIZE(ad), sd,
						  ARRAY_SIZE(sd));
	if (ret)
	{
		LOG_ERR("Advertising failed to start (error: %d)", ret);
		goto end;
	}

	// Initialize the ring buffer for BLE messages
	ring_buf_init(&ble_msg_ring_buf, sizeof(ble_msg_ring_buf_data), ble_msg_ring_buf_data);

	// Create and start the BLE message handling thread
	ble_thread_tid = k_thread_create(&ble_thread_data, ble_thread_stack,
									 K_THREAD_STACK_SIZEOF(ble_thread_stack),
									 ble_thread_handler, NULL, NULL, NULL,
									 BLE_THREAD_PRIORITY, 0, K_NO_WAIT);

	if (!ble_thread_tid)
	{
		LOG_ERR("Failed to create BLE message thread");
		ret = -ENOMEM;
		goto end;
	}

	k_thread_name_set(ble_thread_tid, "ble_msg_thread");
	LOG_INF("BLE message thread created successfully");

end:
	return ret;
}

// Modified bt_nus_printf to use ring buffer and thread
int bt_nus_printf(const char *fmt, ...)
{
	if (!current_conn)
	{
		return -ENOTCONN;
	}

	char message_buffer[BLE_MSG_MAX_SIZE];
	va_list args;
	va_start(args, fmt);
	int len = vsnprintk(message_buffer, sizeof(message_buffer), fmt, args);
	va_end(args);

	if (len < 0)
	{
		return len;
	}

	// Ensure null-termination
	message_buffer[sizeof(message_buffer) - 1] = '\0';

	// Adjust length if truncated
	if (len >= sizeof(message_buffer))
	{
		len = sizeof(message_buffer) - 1;
	}

	return bt_nus_printf_buffer(message_buffer, len);
}

// ISR-safe version that can be called from any context
int bt_nus_printf_buffer(const char *buffer, size_t len)
{
	if (!current_conn)
	{
		return -ENOTCONN;
	}

	if (!buffer || len == 0)
	{
		return -EINVAL;
	}

	// Limit length to our maximum
	if (len > BLE_MSG_MAX_SIZE - 1)
	{
		len = BLE_MSG_MAX_SIZE - 1;
	}

	// Check if we're in ISR context
	bool in_isr = k_is_in_isr();

	// Check if ring buffer has enough space (message length + 2 bytes for length header)
	uint32_t space_needed = len + sizeof(uint16_t);
	if (ring_buf_space_get(&ble_msg_ring_buf) < space_needed)
	{
		if (!in_isr)
		{
			LOG_WRN("Ring buffer full, dropping message");
		}
		return -ENOMEM;
	}

	// Add message length header to ring buffer
	uint16_t msg_len = (uint16_t)len;
	if (ring_buf_put(&ble_msg_ring_buf, (uint8_t *)&msg_len, sizeof(msg_len)) != sizeof(msg_len))
	{
		if (!in_isr)
		{
			LOG_ERR("Failed to add message length to ring buffer");
		}
		return -ENOMEM;
	}

	// Add message data to ring buffer
	if (ring_buf_put(&ble_msg_ring_buf, (uint8_t *)buffer, len) != len)
	{
		if (!in_isr)
		{
			LOG_ERR("Failed to add message data to ring buffer");
		}
		return -ENOMEM;
	}

	// Signal the thread that a new message is available
	// k_sem_give is ISR-safe in Zephyr
	k_sem_give(&ble_msg_sem);

	return len;
}

// Ultra-safe printf for callback contexts
int bt_nus_printf_safe(const char *msg)
{
	if (!msg)
	{
		return -EINVAL;
	}

	size_t len = strlen(msg);
	return bt_nus_printf_buffer(msg, len);
}

// Get ring buffer statistics for debugging
void ble_utils_get_ring_buffer_stats(uint32_t *used_bytes, uint32_t *free_bytes, uint32_t *total_bytes)
{
	if (used_bytes)
	{
		*used_bytes = ring_buf_size_get(&ble_msg_ring_buf);
	}

	if (free_bytes)
	{
		*free_bytes = ring_buf_space_get(&ble_msg_ring_buf);
	}

	if (total_bytes)
	{
		*total_bytes = BLE_MSG_RING_BUF_SIZE;
	}
}

// Clear the ring buffer (flush all pending messages)
void ble_utils_clear_ring_buffer(void)
{
	ring_buf_reset(&ble_msg_ring_buf);
	LOG_INF("Ring buffer cleared");
}
```

## src/ble_utils.h
```c
/**
 * @file
 * @defgroup ble_utils Bluetooth LE utilities API
 * @{
 */

/*
 * Copyright (c) 2020 Nordic Semiconductor ASA
 *
 * SPDX-License-Identifier: LicenseRef-Nordic-5-Clause
 */

#ifndef __BLE_UTILS_H__
#define __BLE_UTILS_H__

#include <bluetooth/services/nus.h>

/** @brief Type indicates function called when Bluetooth LE connection
 *         is established.
 *
 * @param[in] item pointer to work item.
 */
typedef void (*ble_connection_cb_t)(struct k_work *item);

/** @brief Type indicates function called when Bluetooth LE connection is ended.
 *
 * @param[in] item pointer to work item.
 */
typedef void (*ble_disconnection_cb_t)(struct k_work *item);

/** @brief Initialize CoAP utilities.
 *
 * @param[in] on_nus_received function to call when NUS receives message
 * @param[in] on_nus_send     function to call when NUS sends message
 * @param[in] on_connect      function to call when Bluetooth LE connection
 *                            is established
 * @param[in] on_disconnect   function to call when Bluetooth LE connection
 *                            is ended
 * @retval 0    On success.
 * @retval != 0 On failure.
 */
int ble_utils_init(struct bt_nus_cb *nus_clbs,
				   ble_connection_cb_t on_connect,
				   ble_disconnection_cb_t on_disconnect);

int bt_nus_printf(const char *fmt, ...);

#endif

/**
 * @}
 */
```

## src/coap_client.c
```c
/*
 * Copyright (c) 2020 Nordic Semiconductor ASA
 *
 * SPDX-License-Identifier: LicenseRef-Nordic-5-Clause
 */

#include <zephyr/kernel.h>
#include <zephyr/logging/log.h>
#include <ram_pwrdn.h>
#include <zephyr/device.h>
#include <zephyr/pm/device.h>
#include <zephyr/net/coap.h>
#include <nrfx.h> // For NRF_FICR access
#include <zephyr/net/net_if.h>
#include <zephyr/net/net_mgmt.h>
#include "coap_client_utils.h"
#include "dns_utils.h"
#include "net_utils.h"

#if CONFIG_BT_NUS
#include "ble_utils.h"
#endif

LOG_MODULE_REGISTER(coap_client, CONFIG_COAP_CLIENT_LOG_LEVEL);

#if CONFIG_BT_NUS

#define COMMAND_REQUEST_UNICAST 'u'
#define COMMAND_REQUEST_MULTICAST 'm'
#define COMMAND_REQUEST_PROVISIONING 'p'
#define COMMAND_REQUEST_TIME 't'
#define COMMAND_REQUEST_DNS 'd'
#define COMMAND_REQUEST_NETDATA 'i'			   // Add this line
#define COMMAND_REQUEST_TIME_FROM_RESOLVED 'r' // Request time from resolved address
#define COMMAND_REQUEST_CPU_ID 'c'			   // Print unique CPU ID and MAC address
#define COMMAND_REQUEST_TOGGLE_MODE 's'		   // Toggle SED/MED mode
#define COMMAND_REQUEST_DATASET 'o'			   // Display operational dataset

#define CONFIG_COAP_SAMPLE_SERVER_HOSTNAME "srv-ss.vibromatika.by"

static void on_nus_received(struct bt_conn *conn, const uint8_t *const data, uint16_t len)
{
	LOG_INF("Received data: %c", data[0]);

	switch (*data)
	{
	case COMMAND_REQUEST_UNICAST:
		coap_client_toggle_one_light();
		break;

	case COMMAND_REQUEST_MULTICAST:
		coap_client_toggle_mesh_lights();
		break;

	case COMMAND_REQUEST_PROVISIONING:
		coap_client_send_provisioning_request();
		break;

	case COMMAND_REQUEST_TIME:
	{
		coap_client_get_time();
	}
	break;

	case COMMAND_REQUEST_DNS:
	{
		// Example hostname, replace with actual server hostname
		const char *hostname = CONFIG_COAP_SAMPLE_SERVER_HOSTNAME;
		LOG_INF("Starting DNS resolution for: %s", hostname);
		bt_nus_printf("Starting DNS resolution for: %s\n", hostname);
		coap_client_resolve_hostname(hostname);
	}
	break;

	case COMMAND_REQUEST_NETDATA: // Add this case
	{
		LOG_INF("Displaying OpenThread Network Data");
		cmd_show_netdata();
	}
	break;

	case COMMAND_REQUEST_TIME_FROM_RESOLVED: // Request time from resolved address
	{
		LOG_INF("Requesting time from resolved address");
		bt_nus_printf("Requesting time from resolved address\n");

		// Check if we have a resolved address
		if (coap_client_is_address_resolved())
		{
			struct sockaddr_in6 server_addr;
			int result = coap_client_get_resolved_address(&server_addr);

			if (result == 0)
			{
				// We have a valid resolved address, request time from it
				LOG_INF("Using resolved address for time request");
				bt_nus_printf("Using resolved address for time request\n");

				// Call the time request function with the resolved address
				coap_client_get_time_from_address(&server_addr);
			}
			else
			{
				LOG_ERR("Failed to get resolved address: %d", result);
				bt_nus_printf("Failed to get resolved address: %d\n", result);
			}
		}
		else
		{
			LOG_WRN("No resolved address available. Use 'd' command to resolve DNS first");
			bt_nus_printf("No resolved address available. Use 'd' command to resolve DNS first\n");
		}
	}
	break;

	case COMMAND_REQUEST_CPU_ID: // Print unique CPU ID
	{
		LOG_INF("Printing unique CPU ID and MAC address");
		bt_nus_printf("Printing unique CPU ID and MAC address\n");

		// Get the unique device ID from hardware
		uint32_t cpu_id[2]; // Nordic chips typically have 64-bit unique ID

// Read the unique device ID registers
// For nRF52/nRF53 series, the unique ID is in FICR (Factory Information Configuration Registers)
#if defined(NRF_FICR_S) // nRF53 series
		cpu_id[0] = NRF_FICR_S->DEVICEID[0];
		cpu_id[1] = NRF_FICR_S->DEVICEID[1];
#elif defined(NRF_FICR) // nRF52 series and others
		cpu_id[0] = NRF_FICR->DEVICEID[0];
		cpu_id[1] = NRF_FICR->DEVICEID[1];
#else
		// Fallback - try to read from memory mapped addresses
		cpu_id[0] = *(volatile uint32_t *)0x10000060; // DEVICEID[0]
		cpu_id[1] = *(volatile uint32_t *)0x10000064; // DEVICEID[1]
#endif

		LOG_INF("CPU ID: 0x%08X%08X", cpu_id[1], cpu_id[0]);
		bt_nus_printf("=== Device Information ===\n");
		bt_nus_printf("CPU ID: 0x%08X%08X\n", cpu_id[1], cpu_id[0]);

		// Also print in separate parts for easier reading
		bt_nus_printf("CPU ID (High): 0x%08X\n", cpu_id[1]);
		bt_nus_printf("CPU ID (Low):  0x%08X\n", cpu_id[0]);

		// Get MAC address information
		struct net_if *iface = net_if_get_default();
		if (iface != NULL)
		{
			struct net_linkaddr *link_addr = net_if_get_link_addr(iface);
			if (link_addr && link_addr->addr && link_addr->len >= 6)
			{
				bt_nus_printf("MAC Address: %02X:%02X:%02X:%02X:%02X:%02X\n",
							  link_addr->addr[0], link_addr->addr[1], link_addr->addr[2],
							  link_addr->addr[3], link_addr->addr[4], link_addr->addr[5]);
				LOG_INF("MAC Address: %02X:%02X:%02X:%02X:%02X:%02X",
						link_addr->addr[0], link_addr->addr[1], link_addr->addr[2],
						link_addr->addr[3], link_addr->addr[4], link_addr->addr[5]);
			}
			else
			{
				bt_nus_printf("MAC Address: Not available or invalid length\n");
				LOG_WRN("MAC Address: Not available or invalid length");
			}

			// Print interface information
			bt_nus_printf("Interface: %s\n", iface->if_dev->dev->name);
			bt_nus_printf("Interface Index: %d\n", net_if_get_by_iface(iface));
		}
		else
		{
			bt_nus_printf("MAC Address: Network interface not available\n");
			LOG_WRN("Network interface not available");
		}

// Print additional chip information if available
#if defined(NRF_FICR_S)
		bt_nus_printf("Chip: nRF53 series (FICR_S registers)\n");
#elif defined(NRF_FICR)
		bt_nus_printf("Chip: nRF52 series (FICR registers)\n");
		// Print part and variant info if available
		if (NRF_FICR->INFO.PART != 0xFFFFFFFF)
		{
			bt_nus_printf("Part: 0x%08X, Variant: 0x%08X\n",
						  NRF_FICR->INFO.PART, NRF_FICR->INFO.VARIANT);
		}
#else
		bt_nus_printf("Chip: Unknown (memory-mapped fallback)\n");
#endif
		bt_nus_printf("========================\n");
	}
	break;

	case COMMAND_REQUEST_TOGGLE_MODE: // Toggle SED/MED mode
	{
		LOG_INF("Toggling SED/MED mode");
		bt_nus_printf("Toggling SED/MED mode\n");
		coap_client_toggle_minimal_sleepy_end_device();
	}
	break;

	case COMMAND_REQUEST_DATASET: // Display operational dataset
	{
		LOG_INF("Displaying operational dataset");
		bt_nus_printf("Displaying operational dataset\n");
		display_operational_dataset();
	}
	break;

	default:
		LOG_WRN("Received invalid data from NUS");
	}
}

static void on_ble_connect(struct k_work *item)
{
	ARG_UNUSED(item);
}

static void on_ble_disconnect(struct k_work *item)
{
	ARG_UNUSED(item);
}

#endif /* CONFIG_BT_NUS */

static void on_ot_connect(struct k_work *item)
{
	ARG_UNUSED(item);

	bt_nus_printf("OpenThread disconnected\n");
}

static void on_ot_disconnect(struct k_work *item)
{
	ARG_UNUSED(item);

	bt_nus_printf("OpenThread disconnected\n");
}

static void on_mtd_mode_toggle(uint32_t med)
{
	// #if IS_ENABLED(CONFIG_PM_DEVICE) && DT_HAS_CHOSEN(zephyr_console)
	// 	const struct device *cons = DEVICE_DT_GET(DT_CHOSEN(zephyr_console));

	// 	if (!device_is_ready(cons))
	// 	{
	// 		return;
	// 	}

	// 	if (med)
	// 	{
	// 		pm_device_action_run(cons, PM_DEVICE_ACTION_RESUME);
	// 	}
	// 	else
	// 	{
	// 		pm_device_action_run(cons, PM_DEVICE_ACTION_SUSPEND);
	// 	}
	// #else
	// 	ARG_UNUSED(med);
	// 	// Console device not available or PM not enabled
	// #endif
}

// DNS resolution callback

int main(void)
{
	int ret;

	LOG_INF("Start CoAP-client sample");

	if (IS_ENABLED(CONFIG_RAM_POWER_DOWN_LIBRARY))
	{
		power_down_unused_ram();
	}

#if CONFIG_BT_NUS
	struct bt_nus_cb nus_clbs = {
		.received = on_nus_received,
		.sent = NULL,
	};

	ret = ble_utils_init(&nus_clbs, on_ble_connect, on_ble_disconnect);
	if (ret)
	{
		LOG_ERR("Cannot init BLE utilities");
		return 0;
	}

#endif /* CONFIG_BT_NUS */

	coap_client_utils_init(on_ot_connect, on_ot_disconnect, on_mtd_mode_toggle);

	// Initialize DNS utilities
	dns_utils_init();

	LOG_INF("Available BLE commands:");
	LOG_INF("  'u' - Toggle unicast light");
	LOG_INF("  'm' - Toggle multicast lights");
	LOG_INF("  'p' - Send provisioning request");
	LOG_INF("  't' - Get time from default server");
	LOG_INF("  'd' - Resolve DNS for hostname");
	LOG_INF("  'r' - Request time from resolved address");
	LOG_INF("  'i' - Show network data");
	LOG_INF("  'c' - Print unique CPU ID and MAC address");
	LOG_INF("  's' - Toggle SED/MED mode");
	LOG_INF("  'o' - Display operational dataset");

	bt_nus_printf("CoAP Client started. Available commands:\n");
	bt_nus_printf("  'u' - Toggle unicast light\n");
	bt_nus_printf("  'm' - Toggle multicast lights\n");
	bt_nus_printf("  'p' - Send provisioning request\n");
	bt_nus_printf("  't' - Get time from default server\n");
	bt_nus_printf("  'd' - Resolve DNS for hostname\n");
	bt_nus_printf("  'r' - Request time from resolved address\n");
	bt_nus_printf("  'i' - Show network data\n");
	bt_nus_printf("  'c' - Print unique CPU ID and MAC address\n");
	bt_nus_printf("  's' - Toggle SED/MED mode\n");
	bt_nus_printf("  'o' - Display operational dataset\n");

	return 0;
}

// Function to resolve hostname
```

## src/coap_client_utils.c
```c
/*
 * Copyright (c) 2020 Nordic Semiconductor ASA
 *
 * SPDX-License-Identifier: LicenseRef-Nordic-5-Clause
 */

#include <zephyr/kernel.h>
#include <coap_server_client_interface.h>
#include <net/coap_utils.h>
#include <zephyr/logging/log.h>
#include <zephyr/net/openthread.h>
#include <zephyr/net/socket.h>
#include <zephyr/net/coap.h>
#include <zephyr/net/net_ip.h>
#include <openthread/thread.h>
#include <zephyr/net/dns_resolve.h>
#include <zephyr/bluetooth/services/nus.h>
#include <stdio.h>
#include "coap_client_utils.h"
int bt_nus_printf(const char *fmt, ...);

LOG_MODULE_REGISTER(coap_client_utils, CONFIG_COAP_CLIENT_UTILS_LOG_LEVEL);

#define RESPONSE_POLL_PERIOD 100

static uint32_t poll_period;

bool thread_is_connected;

#define COAP_CLIENT_WORKQ_STACK_SIZE 2048
#define COAP_CLIENT_WORKQ_PRIORITY 5

K_THREAD_STACK_DEFINE(coap_client_workq_stack_area, COAP_CLIENT_WORKQ_STACK_SIZE);
static struct k_work_q coap_client_workq;

static struct k_work unicast_light_work;
static struct k_work multicast_light_work;
static struct k_work toggle_MTD_SED_work;
static struct k_work set_med_mode_work;
static struct k_work provisioning_work;
static struct k_work coap_get_time_work;
static struct k_work on_connect_work;
static struct k_work on_disconnect_work;
static struct k_work coap_get_time_from_address_work;

// Static variable to store target address for time request
static struct sockaddr_in6 target_time_server_addr;

mtd_mode_toggle_cb_t on_mtd_mode_toggle;

/* Options supported by the server */
static const char *const light_option[] = {LIGHT_URI_PATH, NULL};
static const char *const provisioning_option[] = {PROVISIONING_URI_PATH,
												  NULL};

/* Thread multicast mesh local address */
static struct sockaddr_in6 multicast_local_addr = {
	.sin6_family = AF_INET6,
	.sin6_port = htons(COAP_PORT),
	.sin6_addr.s6_addr = {0xff, 0x03, 0x00, 0x00, 0x00, 0x00, 0x00, 0x00,
						  0x00, 0x00, 0x00, 0x00, 0x00, 0x00, 0x00, 0x01},
	.sin6_scope_id = 0U};
// Send request to fd15:7938:9154:b17:0:ff:fe00:fc10
static struct sockaddr_in6 coap_server_addr = {
	.sin6_family = AF_INET6,
	.sin6_port = htons(COAP_PORT),
	.sin6_addr.s6_addr = {
		0xfd, 0x15, 0x79, 0x38, 0x91, 0x54, 0x0b, 0x17,
		0x00, 0x00, 0x00, 0xff, 0xfe, 0x00, 0xfc, 0x10},
	.sin6_scope_id = 0U};
/* Variable for storing server address acquiring in provisioning handshake */
static char unique_local_addr_str[INET6_ADDRSTRLEN];
static struct sockaddr_in6 unique_local_addr = {
	.sin6_family = AF_INET6,
	.sin6_port = htons(COAP_PORT),
	.sin6_addr.s6_addr = {
		0,
	},
	.sin6_scope_id = 0U};

typedef struct
{
	uint64_t timestamp;
	int16_t acc[3];
	int16_t gyr[3];
	double temperature;
	double voltage; // Port number
} _ss_data_payload;

static _ss_data_payload ss_data_payload = {
	.timestamp = 0,
	.acc = {0, 0, 0},
	.gyr = {0, 0, 0},
	.temperature = 0.0f,
	.voltage = 0.0f};

static bool is_mtd_in_med_mode(otInstance *instance)
{
	return otThreadGetLinkMode(instance).mRxOnWhenIdle;
}
static char str[256] = "";
static void poll_period_response_set(void)
{
	otError error;

	otInstance *instance = openthread_get_default_instance();

	if (is_mtd_in_med_mode(instance))
	{
		return;
	}

	if (!poll_period)
	{
		poll_period = otLinkGetPollPeriod(instance);

		error = otLinkSetPollPeriod(instance, RESPONSE_POLL_PERIOD);
		__ASSERT(error == OT_ERROR_NONE, "Failed to set pool period");

		LOG_INF("Poll Period: %dms set", RESPONSE_POLL_PERIOD);
	}
}

static void poll_period_restore(void)
{
	otError error;
	otInstance *instance = openthread_get_default_instance();

	if (is_mtd_in_med_mode(instance))
	{
		return;
	}

	if (poll_period)
	{
		error = otLinkSetPollPeriod(instance, poll_period);
		__ASSERT_NO_MSG(error == OT_ERROR_NONE);

		LOG_INF("Poll Period: %dms restored", poll_period);
		poll_period = 0;
	}
}

static int on_provisioning_reply(const struct coap_packet *response,
								 struct coap_reply *reply,
								 const struct sockaddr *from)
{
	int ret = 0;
	const uint8_t *payload;
	uint16_t payload_size = 0u;

	ARG_UNUSED(reply);
	ARG_UNUSED(from);

	payload = coap_packet_get_payload(response, &payload_size);

	if (payload == NULL ||
		payload_size != sizeof(unique_local_addr.sin6_addr))
	{
		LOG_ERR("Received data is invalid");
		ret = -EINVAL;
		goto exit;
	}

	memcpy(&unique_local_addr.sin6_addr, payload, payload_size);

	if (!zsock_inet_ntop(AF_INET6, payload, unique_local_addr_str,
						 INET6_ADDRSTRLEN))
	{
		LOG_ERR("Received data is not IPv6 address: %d", errno);
		ret = -errno;
		goto exit;
	}

	LOG_INF("Received peer address: %s", unique_local_addr_str);

exit:
	if (IS_ENABLED(CONFIG_OPENTHREAD_MTD_SED))
	{
		poll_period_restore();
	}

	return ret;
}
static int on_time_reply(const struct coap_packet *response,
						 struct coap_reply *reply,
						 const struct sockaddr *from)
{
	int ret = 0;
	const uint8_t *payload;

	uint16_t payload_size = 0u;

	ARG_UNUSED(reply);
	ARG_UNUSED(from);

	payload = coap_packet_get_payload(response, &payload_size);
	// copy payload to str
	if (payload == NULL || (payload_size + 1) >= sizeof(str))
	{
		LOG_ERR("Received data is invalid");
		bt_nus_printf("Received data is invalid");
		ret = -EINVAL;
		goto exit;
	}
	memcpy(str, payload, payload_size);
	str[payload_size] = '\0'; // Null-terminate the string
							  //	bt_nus_printf("Payload:%s", str);

	LOG_INF("Received peer address: %s", unique_local_addr_str);
	bt_nus_printf("Received peer address: %s\nPayload:%s\n", unique_local_addr_str, str);

exit:
	if (IS_ENABLED(CONFIG_OPENTHREAD_MTD_SED))
	{
		poll_period_restore();
	}

	return ret;
}
static void toggle_one_light(struct k_work *item)
{
	uint8_t payload = (uint8_t)THREAD_COAP_UTILS_LIGHT_CMD_TOGGLE;

	ARG_UNUSED(item);

	if (unique_local_addr.sin6_addr.s6_addr16[0] == 0)
	{
		LOG_WRN("Peer address not set. Activate 'provisioning' option "
				"on the server side");
		return;
	}

	LOG_INF("Send 'light' request to: %s", unique_local_addr_str);
	coap_send_request(COAP_METHOD_PUT,
					  (const struct sockaddr *)&unique_local_addr,
					  light_option, &payload, sizeof(payload), NULL);
}

static void toggle_mesh_lights(struct k_work *item)
{
	static uint8_t command = (uint8_t)THREAD_COAP_UTILS_LIGHT_CMD_OFF;

	ARG_UNUSED(item);

	command = ((command == THREAD_COAP_UTILS_LIGHT_CMD_OFF) ? THREAD_COAP_UTILS_LIGHT_CMD_ON : THREAD_COAP_UTILS_LIGHT_CMD_OFF);

	LOG_INF("Send multicast mesh 'light' request");
	coap_send_request(COAP_METHOD_PUT,
					  (const struct sockaddr *)&multicast_local_addr,
					  light_option, &command, sizeof(command), NULL);
}

static void send_provisioning_request(struct k_work *item)
{
	ARG_UNUSED(item);

	if (IS_ENABLED(CONFIG_OPENTHREAD_MTD_SED))
	{
		/* decrease the polling period for higher responsiveness */
		poll_period_response_set();
	}

	LOG_INF("Send 'provisioning' request");
	coap_send_request(COAP_METHOD_GET,
					  (const struct sockaddr *)&multicast_local_addr,
					  provisioning_option, NULL, 0u, on_provisioning_reply);
}

static void coap_get_time(struct k_work *item)
{
	char payload[256];
	// Serialize ss_data_payload to a json string
	int ret = snprintf(payload, sizeof(payload),
					   "{\"timestamp\":%llu,\"acc\":[%d,%d,%d],"
					   "\"gyr\":[%d,%d,%d],\"temperature\":%.2f,\"voltage\":%.2f}",
					   ss_data_payload.timestamp,
					   ss_data_payload.acc[0], ss_data_payload.acc[1], ss_data_payload.acc[2],
					   ss_data_payload.gyr[0], ss_data_payload.gyr[1], ss_data_payload.gyr[2],
					   ss_data_payload.temperature, ss_data_payload.voltage);

	// const char *server_ip = "178.172.137.254"; // Example IPv4 address
	//  send the payload to the server
	if (ret < 0 || ret >= sizeof(payload))
	{
		LOG_ERR("Failed to format payload");
		return;
	}
	// add path "measurements" to server request
	const char *const path[] = {"time", NULL};

	ret = coap_send_request(COAP_METHOD_GET,
							(const struct sockaddr *)&coap_server_addr,
							path, NULL, 0, &on_time_reply);
	if (ret < 0)
	{
		bt_nus_printf("Failed to send CoAP request: %d", ret);
		return;
	};
	bt_nus_printf("Request sended !\n");
}

static void coap_get_time_from_address(struct k_work *item)
{
	ARG_UNUSED(item);

	char payload[256];

	// Serialize ss_data_payload to a json string
	int ret = snprintf(payload, sizeof(payload),
					   "{\"timestamp\":%llu,\"acc\":[%d,%d,%d],"
					   "\"gyr\":[%d,%d,%d],\"temperature\":%.2f,\"voltage\":%.2f}",
					   ss_data_payload.timestamp,
					   ss_data_payload.acc[0], ss_data_payload.acc[1], ss_data_payload.acc[2],
					   ss_data_payload.gyr[0], ss_data_payload.gyr[1], ss_data_payload.gyr[2],
					   ss_data_payload.temperature, ss_data_payload.voltage);

	if (ret < 0 || ret >= sizeof(payload))
	{
		LOG_ERR("Failed to format payload");
		bt_nus_printf("Failed to format payload\n");
		return;
	}

	// Add path "time" to server request
	const char *const path[] = {"time", NULL};

	ret = coap_send_request(COAP_METHOD_GET,
							(const struct sockaddr *)&target_time_server_addr,
							path, NULL, 0, &on_time_reply);
	if (ret < 0)
	{
		bt_nus_printf("Failed to send CoAP request to resolved address: %d\n", ret);
		return;
	}

	char addr_str[INET6_ADDRSTRLEN];
	if (zsock_inet_ntop(AF_INET6, &target_time_server_addr.sin6_addr, addr_str, sizeof(addr_str)))
	{
		bt_nus_printf("Time request sent to resolved address: %s\n", addr_str);
	}
	else
	{
		bt_nus_printf("Time request sent to resolved address\n");
	}
}

static void toggle_minimal_sleepy_end_device(struct k_work *item)
{
	otError error;
	otLinkModeConfig mode;
	struct openthread_context *context = openthread_get_default_context();

	__ASSERT_NO_MSG(context != NULL);

	openthread_api_mutex_lock(context);
	mode = otThreadGetLinkMode(context->instance);

	LOG_INF("Current mode before toggle: %s", mode.mRxOnWhenIdle ? "MED" : "SED");
	bt_nus_printf("Current mode before toggle: %s\n", mode.mRxOnWhenIdle ? "MED" : "SED");

	mode.mRxOnWhenIdle = !mode.mRxOnWhenIdle;
	error = otThreadSetLinkMode(context->instance, mode);
	openthread_api_mutex_unlock(context);

	if (error != OT_ERROR_NONE)
	{
		LOG_ERR("Failed to set MLE link mode configuration");
	}
	else
	{
		LOG_INF("Mode toggled to: %s", mode.mRxOnWhenIdle ? "MED" : "SED");
		bt_nus_printf("Mode toggled to: %s\n", mode.mRxOnWhenIdle ? "MED" : "SED");
		on_mtd_mode_toggle(mode.mRxOnWhenIdle);
	}
}

static void update_device_state(void)
{
	struct otInstance *instance = openthread_get_default_instance();
	otLinkModeConfig mode = otThreadGetLinkMode(instance);
	on_mtd_mode_toggle(mode.mRxOnWhenIdle);
}

static void set_device_to_med_mode(void)
{
	otError error;
	otLinkModeConfig mode;
	struct openthread_context *context = openthread_get_default_context();

	if (context == NULL)
	{
		LOG_ERR("OpenThread context not available");
		return;
	}

	openthread_api_mutex_lock(context);
	mode = otThreadGetLinkMode(context->instance);

	// Set to MED mode (Minimal End Device) - RxOnWhenIdle = true
	mode.mRxOnWhenIdle = true;

	error = otThreadSetLinkMode(context->instance, mode);
	openthread_api_mutex_unlock(context);

	if (error != OT_ERROR_NONE)
	{
		LOG_ERR("Failed to set device to MED mode: %d", error);
	}
	else
	{
		LOG_INF("Device initialized in MED (Minimal End Device) mode");
		bt_nus_printf("Device initialized in MED (Minimal End Device) mode\n");
		on_mtd_mode_toggle(mode.mRxOnWhenIdle);
	}
}

static void set_med_mode_work_handler(struct k_work *work)
{
	ARG_UNUSED(work);
	// Add a small delay to ensure OpenThread is fully initialized
	k_sleep(K_MSEC(1000));
	set_device_to_med_mode();
}

static void on_thread_state_changed(otChangedFlags flags, struct openthread_context *ot_context,
									void *user_data)
{
	if (flags & OT_CHANGED_THREAD_ROLE)
	{
		switch (otThreadGetDeviceRole(ot_context->instance))
		{
		case OT_DEVICE_ROLE_CHILD:
		case OT_DEVICE_ROLE_ROUTER:
		case OT_DEVICE_ROLE_LEADER:
			k_work_submit_to_queue(&coap_client_workq, &on_connect_work);
			thread_is_connected = true;
			break;

		case OT_DEVICE_ROLE_DISABLED:
		case OT_DEVICE_ROLE_DETACHED:
		default:
			k_work_submit_to_queue(&coap_client_workq, &on_disconnect_work);
			thread_is_connected = false;
			break;
		}
	}
}
static struct openthread_state_changed_cb ot_state_chaged_cb = {
	.state_changed_cb = on_thread_state_changed};

static void submit_work_if_connected(struct k_work *work)
{
	if (thread_is_connected)
	{
		k_work_submit_to_queue(&coap_client_workq, work);
	}
	else
	{
		LOG_INF("Connection is broken");
	}
}

void coap_client_utils_init(ot_connection_cb_t on_connect,
							ot_disconnection_cb_t on_disconnect,
							mtd_mode_toggle_cb_t on_toggle)
{
	on_mtd_mode_toggle = on_toggle;

	coap_init(AF_INET6, NULL);

	k_work_queue_init(&coap_client_workq);

	k_work_queue_start(&coap_client_workq, coap_client_workq_stack_area,
					   K_THREAD_STACK_SIZEOF(coap_client_workq_stack_area),
					   COAP_CLIENT_WORKQ_PRIORITY, NULL);

	k_work_init(&on_connect_work, on_connect);
	k_work_init(&on_disconnect_work, on_disconnect);
	k_work_init(&unicast_light_work, toggle_one_light);
	k_work_init(&multicast_light_work, toggle_mesh_lights);
	k_work_init(&provisioning_work, send_provisioning_request);
	k_work_init(&coap_get_time_work, coap_get_time);
	k_work_init(&coap_get_time_from_address_work, coap_get_time_from_address);
	k_work_init(&set_med_mode_work, set_med_mode_work_handler);

	openthread_state_changed_cb_register(openthread_get_default_context(), &ot_state_chaged_cb);
	openthread_start(openthread_get_default_context());

	if (IS_ENABLED(CONFIG_OPENTHREAD_MTD_SED))
	{
		k_work_init(&toggle_MTD_SED_work,
					toggle_minimal_sleepy_end_device);
		// Initialize device in MED mode instead of default SED mode
		k_work_submit(&set_med_mode_work);
	}
}

void coap_client_toggle_one_light(void)
{
	submit_work_if_connected(&unicast_light_work);
}

void coap_client_toggle_mesh_lights(void)
{
	submit_work_if_connected(&multicast_light_work);
}

void coap_client_send_provisioning_request(void)
{
	submit_work_if_connected(&provisioning_work);
}
void coap_client_get_time()
{
	submit_work_if_connected(&coap_get_time_work);
}

void coap_client_get_time_from_address(const struct sockaddr_in6 *server_addr)
{
	if (!server_addr)
	{
		LOG_ERR("Invalid server address");
		bt_nus_printf("Invalid server address\n");
		return;
	}

	// Copy the target address to our static variable
	memcpy(&target_time_server_addr, server_addr, sizeof(struct sockaddr_in6));

	// Submit the work item
	submit_work_if_connected(&coap_get_time_from_address_work);
}

void coap_client_toggle_minimal_sleepy_end_device(void)
{
	if (IS_ENABLED(CONFIG_OPENTHREAD_MTD_SED))
	{
		k_work_submit_to_queue(&coap_client_workq, &toggle_MTD_SED_work);
	}
}
```

## src/coap_client_utils.h
```c
/**
 * @file
 * @defgroup coap_client_utils API for coap_client_* samples
 * @{
 */

/*
 * Copyright (c) 2020 Nordic Semiconductor ASA
 *
 * SPDX-License-Identifier: LicenseRef-Nordic-5-Clause
 */

#ifndef __COAP_CLIENT_UTILS_H__
#define __COAP_CLIENT_UTILS_H__

/** @brief Type indicates function called when OpenThread connection
 *         is established.
 *
 * @param[in] item pointer to work item.
 */
typedef void (*ot_connection_cb_t)(struct k_work *item);

/** @brief Type indicates function called when OpenThread connection is ended.
 *
 * @param[in] item pointer to work item.
 */
typedef void (*ot_disconnection_cb_t)(struct k_work *item);

/** @brief Type indicates function called when the MTD modes are toggled.
 *
 * @param[in] val 1 if the MTD is in MED mode
 *                0 if the MTD is in SED mode
 */
typedef void (*mtd_mode_toggle_cb_t)(uint32_t val);

/** @brief Initialize CoAP client utilities.
 */
void coap_client_utils_init(ot_connection_cb_t on_connect,
							ot_disconnection_cb_t on_disconnect,
							mtd_mode_toggle_cb_t on_toggle);

/** @brief Toggle light on the CoAP server node.
 *
 * @note The CoAP server should be paired before to have an affect.
 */
void coap_client_toggle_one_light(void);

/** @brief Toggle lights on all CoAP servers in the network mesh.
 */
void coap_client_toggle_mesh_lights(void);

/** @brief Request for the CoAP server address to pair.
 *
 * @note Enable paring on the CoAP server to get the address.
 */
void coap_client_send_provisioning_request(void);

void coap_client_get_time(void);

/** @brief Toggle SED to MED and MED to SED modes.
 *
 * @note Active when the device is working as Minimal Thread Device.
 */
void coap_client_toggle_minimal_sleepy_end_device(void);

int coap_send_ipv4_message(const char *server_ip, uint16_t server_port,
						   const char *const *path,
						   uint8_t *payload, size_t payload_len,
						   uint8_t method);

#endif

/**
 * @}
 */
```
